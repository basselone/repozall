#include <ESP8266WiFi.h>
#include <NTPClient.h>
#include <WiFiUdp.h>
#include <Wire.h>
#include <Adafruit_GFX.h>
#include <Adafruit_SSD1306.h>
int selected = 0;
int entered = -1;
#define FRAME_DELAY (42)
#define FRAME_WIDTH (48)
#define FRAME_HEIGHT (48)
#define FRAME_COUNT (sizeof(frames) / sizeof(frames[0]))
const byte PROGMEM frames[][288] = {
  {0,0,0,0,0,0,0,0,0,0,0,0,0,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0,0},
  {0,0,0,0,0,0,0,0,0,0,0,0,0,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0,0},
  {0,0,0,0,0,0,0,0,0,0,0,0,0,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0,0},
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  {0,0,0,0,0,0,0,0,0,0,0,0,0,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0,0}
  };

#define CLK 13
#define DT 12
#define SW 14
#include <GyverEncoder.h>
Encoder enc(CLK, DT, SW);
int demo_mode = 0;
int demo = 0;
#define SCREEN_WIDTH 128 // OLED display width, in pixels
#define SCREEN_HEIGHT 64 // OLED display height, in pixels
const char *ssid = "Matvei";
const char *password = "44444444";
// Declaration for an SSD1306 display connected to I2C (SDA, SCL pins)
Adafruit_SSD1306 display(SCREEN_WIDTH, SCREEN_HEIGHT, &Wire, -1);
WiFiUDP ntpUDP;
NTPClient timeClient(ntpUDP, "pool.ntp.org");
void displaymenu(void) {
   enc.tick();
if (enc.isRight()) {
    selected = selected + 1;
    delay(50);
  };
  
if (enc.isLeft()){
    selected = selected - 1;
    delay(50);
  };

if (enc.isDouble()) {
    entered = selected;
  };

if (enc.isHolded()) {
    entered = -1;
  };
  Serial.println(entered);
  const char *options[11] = { 
    " Menu option 1 ", 
    " Menu option 2 ", 
    " Menu option 3 ", 
    " Menu option 4 ",
    " Menu option 5 ",
    " Menu option 6 ",
    " Menu option 7 ",
    " Menu option 8 ",
    " Menu option 9 ",
    " Menu option 10 ",
    " Menu option 11 "
  };
  
  if(entered == -1) {
    display.clearDisplay();
    display.setTextSize(1);             
    display.setTextColor(SSD1306_WHITE);
    display.setCursor(0,0);
    display.println(F("Custom menu test"));
    display.println("");
    for(int i=0;i < 7; i++) {
      if(i == selected) {
        display.setTextColor(SSD1306_BLACK, SSD1306_WHITE);
        display.println(options[i]);
      } else if(i != selected){
        display.setTextColor(SSD1306_WHITE);
        display.println(options[i]);
      }
    }
  } else if(entered == 0) {
      display.clearDisplay();
      display.setTextSize(1);             
      display.setTextColor(SSD1306_WHITE);
      display.setCursor(0,0);
      display.println(F("Custom menu test"));
      display.println("Menu option 1");
      display.setTextColor(SSD1306_WHITE);
      display.setTextSize(1);
      display.println(utf8rus("работает мульти загрузачность из за 2-ч ядер"));
  } else if(entered == 1) {
      display.clearDisplay();
      display.setTextSize(1);             
      display.setTextColor(SSD1306_WHITE);
      display.setCursor(0,0);
      display.println(F("Custom menu test"));
      display.println("Menu option 2");
      display.setTextColor(SSD1306_WHITE);
      display.setTextSize(2);
      display.println("More cool stuff :)");
  }
  else if(entered == 2) {
      display.clearDisplay();
      display.setTextSize(1);             
      display.setTextColor(SSD1306_WHITE);
      display.setCursor(0,0);
      display.println(F("Custom menu test"));
      display.println("Menu option 3");
      display.setTextColor(SSD1306_WHITE);
      display.setTextSize(2);
      display.println("More cool stuff :)");
  }
  else if(entered == 3) {
      display.clearDisplay();
      display.setTextSize(1);             
      display.setTextColor(SSD1306_WHITE);
      display.setCursor(0,0);
      display.println(F("Custom menu test"));
      display.println("Menu option 4");
      display.setTextColor(SSD1306_WHITE);
      display.setTextSize(2);
      display.println("More cool stuff :)");
  }
  else if(entered == 4) {
      display.clearDisplay();
      display.setTextSize(1);             
      display.setTextColor(SSD1306_WHITE);
      display.setCursor(0,0);
      display.println(F("Custom menu test"));
      display.println("Menu option 5");
      display.setTextColor(SSD1306_WHITE);
      display.setTextSize(2);
      display.println("More cool stuff :)");
  }
  else if(entered == 5) {
      display.clearDisplay();
      display.setTextSize(1);             
      display.setTextColor(SSD1306_WHITE);
      display.setCursor(0,0);
      display.println(F("Custom menu test"));
      display.println("Menu option 6");
      display.setTextColor(SSD1306_WHITE);
      display.setTextSize(2);
      display.println("More cool stuff :)");
  }
    else if(entered == 6) {
      display.clearDisplay();
      display.setTextSize(1);             
      display.setTextColor(SSD1306_WHITE);
      display.setCursor(0,0);
      display.println(F("Custom menu test"));
      display.println("Menu option 7");
      display.setTextColor(SSD1306_WHITE);
      display.setTextSize(2);
      display.println("More cool stuff :)");
  }
  display.display();
}

void setup() {
  Serial.begin(115200);
  enc.setType(TYPE2);
  if(!display.begin(SSD1306_SWITCHCAPVCC, 0x3C)) { // Address 0x3D for 128x64
    Serial.println(F("SSD1306 allocation failed"));
    for(;;);
  }
  
  delay(2000);
  display.cp437(true);
  display.clearDisplay();
  Serial.print("Connecting to ");
  Serial.println(ssid);
  WiFi.begin(ssid, password);
  display.setTextSize(1);
  display.setTextColor(WHITE);
  display.setCursor(10, 5);
  display.println(utf8rus("Подключение к сети"));
  display.setCursor(45, 20);
  display.println("Wi-fi");
  display.display(); 
  while (WiFi.status() != WL_CONNECTED) {
  delay(500);
  }
 timeClient.begin();
 timeClient.setTimeOffset(18000);
 demo_mode = 1;
}
int frame = 0;
void loop() {
  enc.tick();
 timeClient.update();
  if (enc.isRightH()){
  demo_mode = 1;
  }
 if (enc.isLeftH()){
  demo_mode = 0;
  demo = 1;
  }
if (enc.isClick()){
  demo_mode = 3;
  demo = 0;
  }
 if (demo_mode == 1){
  time_t epochTime = timeClient.getEpochTime();
 Serial.print("Epoch Time: ");
 Serial.println(epochTime);
 String formattedTime = timeClient.getFormattedTime();
 int currentHour = timeClient.getHours();
 int currentMinute = timeClient.getMinutes();
 int currentSecond = timeClient.getSeconds();
 struct tm *ptm = gmtime ((time_t *)&epochTime); 
 display.clearDisplay();
 Serial.println("");
 display.setTextSize(2);
 if (currentHour > 9) {
 display.setCursor(17, 25);
 display.println(currentHour);
 }
 else{
 display.setCursor(17, 25);//12 pixels
 display.println("0");
 display.setCursor(29, 25);
 display.println(currentHour);
 }
 display.setCursor(42, 25);
 display.println(":");
 if (currentMinute > 9) {
 display.setCursor(52, 25);
 display.println(currentMinute);
 }
 else{
 display.setCursor(52, 25);//12 pixels
 display.println("0");
 display.setCursor(64, 25);
 display.println(currentMinute);
 }
 display.setCursor(76, 25);
 display.println(":");
 if (currentSecond > 9) {
 display.setCursor(86, 25);
 display.println(currentSecond);
}
 else{
 display.setCursor(86, 25);//12 pixels
 display.println("0");
 display.setCursor(98, 25);
 display.println(currentSecond);
 }

 display.display();
 }
  if (demo == 1){
  
  display.clearDisplay();
  display.drawBitmap(40, 8, frames[frame], FRAME_WIDTH, FRAME_HEIGHT, 1);
  display.display();
  frame = (frame + 1) % FRAME_COUNT;
  delay(FRAME_DELAY);
}

if (demo_mode == 3){
  displaymenu();
}
}
/* Recode russian fonts from UTF-8 to Windows-1251 */
String utf8rus(String source)
{
  int i,k;
  String target;
  unsigned char n;
  char m[2] = { '0', '\0' };
  k = source.length(); i = 0;
  while (i < k) {
    n = source[i]; i++;
    if (n >= 0xC0) {
      switch (n) {
        case 0xD0: {
          n = source[i]; i++;
          if (n == 0x81) { n = 0xA8; break; }
          if (n >= 0x90 && n <= 0xBF) n = n + 0x30;
          break;
        }
        case 0xD1: {
          n = source[i]; i++;
          if (n == 0x91) { n = 0xB8; break; }
          if (n >= 0x80 && n <= 0x8F) n = n + 0x70;
          break;
        }
      }
    }
    m[0] = n; target = target + String(m);
  }
return target;
}